## main/Kconfig.projbuild
```kconfig
menu "HID Example Configuration"
    config EXAMPLE_SSP_ENABLED
        bool "Secure Simple Pairing"
        depends on BT_CLASSIC_ENABLED
        default y
        help
            This enables the Secure Simple Pairing. If disable this option,
            Bluedroid will only support Legacy Pairing

    config EXAMPLE_HID_HOST_ENABLED
        bool "Enable Example HID Host"
        depends on BT_NIMBLE_ENABLED
        default y
        select BT_NIMBLE_HID_SERVICE
        help
            This enables Nimble HID Host

    config EXAMPLE_PEER_DEVICE_NAME
        string "Target Device Name"
        default "HID Mouse Example"
        help
            Use this option to set target device name to connect.
endmenu

menu "CRSF Configuration"
    config CRSF_UART_NUM
        int "CRSF UART Number"
        default 1
        range 0 2
        help
            UART controller number to use for CRSF communication.
    
    config CRSF_TX_PIN
        int "CRSF TX Pin"
        default 17
        range 0 48
        help
            GPIO pin for CRSF TX (transmit).
    
    config CRSF_RX_PIN
        int "CRSF RX Pin"
        default 16
        range 0 48
        help
            GPIO pin for CRSF RX (receive).
endmenu
```
